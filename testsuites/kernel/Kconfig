## testsuites/kernel/Kconfig
```kconfig
# Copyright (c) 2013-2019 Huawei Technologies Co., Ltd. All rights reserved.
# Copyright (c) 2020-2021 Huawei Device Co., Ltd. All rights reserved.
#
# Redistribution and use in source and binary forms, with or without modification,
# are permitted provided that the following conditions are met:
#
# 1. Redistributions of source code must retain the above copyright notice, this list of
# conditions and the following disclaimer.
#
# 2. Redistributions in binary form must reproduce the above copyright notice, this list
# of conditions and the following disclaimer in the documentation and/or other materials
# provided with the distribution.
#
# 3. Neither the name of the copyright holder nor the names of its contributors may be used
# to endorse or promote products derived from this software without specific prior written
# permission.
#
# THIS SOFTWARE IS PROVIDED BY THE COPYRIGHT HOLDERS AND CONTRIBUTORS
# "AS IS" AND ANY EXPRESS OR IMPLIED WARRANTIES, INCLUDING, BUT NOT LIMITED TO,
# THE IMPLIED WARRANTIES OF MERCHANTABILITY AND FITNESS FOR A PARTICULAR
# PURPOSE ARE DISCLAIMED. IN NO EVENT SHALL THE COPYRIGHT HOLDER OR
# CONTRIBUTORS BE LIABLE FOR ANY DIRECT, INDIRECT, INCIDENTAL, SPECIAL,
# EXEMPLARY, OR CONSEQUENTIAL DAMAGES (INCLUDING, BUT NOT LIMITED TO,
# PROCUREMENT OF SUBSTITUTE GOODS OR SERVICES; LOSS OF USE, DATA, OR PROFITS;
# OR BUSINESS INTERRUPTION) HOWEVER CAUSED AND ON ANY THEORY OF LIABILITY,
# WHETHER IN CONTRACT, STRICT LIABILITY, OR TORT (INCLUDING NEGLIGENCE OR
# OTHERWISE) ARISING IN ANY WAY OUT OF THE USE OF THIS SOFTWARE, EVEN IF
# ADVISED OF THE POSSIBILITY OF SUCH DAMAGE.


config TEST_LEVEL
    bool "Enable Test Level"
    default y
    depends on TEST

config TEST_SMOKE
    bool "Enable Test smoke"
    default y
    depends on TEST && TEST_LEVEL

config TEST_FULL
    bool "Enable Test full"
    default y
    depends on TEST && TEST_LEVEL

config TEST_KERNEL_BASE
    bool "Enable Kernel Testsuit"
    default y
    depends on KERNEL_TEST &&  TEST
config TEST_KERNEL_BASE_IPC
    bool "Enable IPC Testsuit"
    default y
    depends on KERNEL_TEST &&  TEST_KERNEL_BASE && TEST
config TEST_KERNEL_BASE_CORE
    bool "Enable CORE Testsuit"
    default y
    depends on KERNEL_TEST &&  TEST_KERNEL_BASE && TEST
config TEST_KERNEL_EXTEND
    bool "Enable Extended Kernel Testsuit"
    default y
    depends on KERNEL_TEST &&  TEST
config TEST_KERNEL_EXTEND_CPUP
    bool "Enable CPUP Testsuit"
    default y
    depends on KERNEL_TEST &&  TEST_KERNEL_EXTEND && TEST
config TEST_POSIX
    bool "Enable Posix Testsuit"
    default y
    depends on KERNEL_TEST &&  TEST
config TEST_POSIX_MUTEX
    bool "Enable Mutex Testsuit"
    default y
    depends on KERNEL_TEST &&  TEST_POSIX && TEST
config TEST_POSIX_PTHREAD
    bool "Enable Pthread Testsuit"
    default y
    depends on KERNEL_TEST &&  TEST_POSIX && TEST
```
