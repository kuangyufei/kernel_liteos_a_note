## kernel/Kconfig
```kconfig
menu "Kernel"
config KERNEL_SMP
    bool "Enable Kernel SMP"
    default n
    help
      This option will enable smp support of LiteOS.

config KERNEL_SMP_CORE_NUM
    int "Multi-processing Core Numbers"
    default 2
    depends on KERNEL_SMP
    help
      This represents the number of multi-processing cores.

config KERNEL_SMP_LOCKDEP
    bool "Enable Spinlock Lockdep Check"
    default n
    depends on KERNEL_SMP
    help
      This option will enable spinlock lockdep check.

config KERNEL_SMP_TASK_SYNC
    bool "Enable Synchronized Task Operations"
    default n
    depends on KERNEL_SMP
    help
      This option will enable task synchronized operate task across cores.

config KERNEL_SMP_CALL
    bool "Enable Function call cross Multi-core"
    default n
    depends on KERNEL_SMP
    help
      This option will enable function call on multi-core.

config KERNEL_SCHED_STATISTICS
    bool "Enable Scheduler statistics"
    default n
    depends on KERNEL_SMP
    help
      This option will enable scheduler statistics.

config KERNEL_MMU
    bool "Enable MMU"
    default y
    help
      This option will enable mmu.

config KERNEL_VM
    bool "Enable VM"
    default y
    depends on KERNEL_MMU
    help
      This option will enable vmm, pmm, page fault, etc.

config KERNEL_SYSCALL
    bool "Enable Syscall"
    default y
    depends on KERNEL_VM
    help
      This option will enable syscall.

config PAGE_TABLE_FINE_LOCK
    bool "Enable fine lock for page table"
    default n
    depends on KERNEL_VM
    help
      This option will enable fine lock for page table.

######################### config options of container ####################
config KERNEL_CONTAINER
    bool "Enable container Feature"
    default n
    depends on KERNEL_VM

config PID_CONTAINER
    bool "Enable pid container Feature"
    default n
    depends on KERNEL_CONTAINER

config UTS_CONTAINER
    bool "Enable uts container Feature"
    default n
    depends on KERNEL_CONTAINER

config MNT_CONTAINER
    bool "Enable mnt container Feature"
    default n
    depends on KERNEL_CONTAINER

config CHROOT
    bool "Enable chroot"
    default n
    depends on MNT_CONTAINER

config IPC_CONTAINER
    bool "Enable ipc container Feature"
    default n
    depends on KERNEL_CONTAINER

config TIME_CONTAINER
    bool "Enable time container"
    default n
    depends on KERNEL_CONTAINER

######################### config options of extended #####################
source "kernel/extended/Kconfig"

config ENABLE_KERNEL_TEST
    bool "Enable kernel test"
    default n
    help
      This option will enable kernel test.

endmenu
```

## kernel/common/blackbox/Kconfig
```kconfig
config BLACKBOX
    bool "Enable BlackBox"
    default n
    help
      Answer Y to enable LiteOS support blackbox

config BLACKBOX_LOG_PART_MOUNT_POINT
    string "unknown"
    default "/storage"
    depends on BLACKBOX
    help
      Define the default log part representative of blackbox

config BLACKBOX_LOG_ROOT_PATH
    string "unknown"
    default "/storage/data/log"
    depends on BLACKBOX
    help
      Define the default log path of blackbox

config BLACKBOX_RESERVE_MEM_ADDR
    int "The address of the reserve mem for blackbox in hex"
    default 0
    depends on BLACKBOX
    help
      Define the address of the reserve mem for blackbox in hex.

config BLACKBOX_LOG_SIZE
    int "The size of log saved by blackbox  in hex"
    range 1024 1048576
    default 65536
    depends on BLACKBOX
    help
      Define the size of log saved by blackbox in decimal.
```

## kernel/common/hidumper/Kconfig
```kconfig
config HIDUMPER
    bool "Enable hidumper"
    default n
    help
      Answer Y to enable LiteOS support hidumper
```

## kernel/extended/Kconfig
```kconfig
config KERNEL_EXTKERNEL
    bool "Enable Extend Kernel"
    default y
    help
      This option will enable extend Kernel of LiteOS.  Extend kernel include
      cppsupport, cpup, and dynload. You can select one or some
      of them.

config KERNEL_CPPSUPPORT
    bool "Enable C++ Support"
    default y
    depends on KERNEL_EXTKERNEL
    help
      If you wish to build LiteOS with support for C++.

config KERNEL_CPUP
    bool "Enable Cpup"
    default y
    depends on KERNEL_EXTKERNEL
    help
      If you wish to build LiteOS with support for cpup.

config CPUP_INCLUDE_IRQ
    bool "Enable Cpup include irq"
    default y
    depends on KERNEL_CPUP
    help
      If you wish to include irq usage for cpup.

config KERNEL_DYNLOAD
    bool "Enable Dynamic Load Feature"
    default y
    depends on KERNEL_EXTKERNEL && KERNEL_VM && KERNEL_SYSCALL
    help
      If you wish to build LiteOS with support for dynamic load.

config ASLR
    bool "Enable Address Space Layout Randomization"
    default n
    depends on KERNEL_DYNLOAD && HW_RANDOM_ENABLE
    help
      If you wish to enable ASLR for user aspace.

config KERNEL_PM
    bool "Enable Power Management"
    default y
    depends on KERNEL_EXTKERNEL
    help
      If you wish to build LiteOS with support for power management.

config KERNEL_VDSO
    bool "Enable VDSO Feature"
    default n
    depends on KERNEL_EXTKERNEL && KERNEL_VM && KERNEL_SYSCALL
    help
      If you wish to speed up some system calls.

config KERNEL_SHM
    bool "Enable Shared Memory"
    default y
    depends on KERNEL_EXTKERNEL && KERNEL_VM && KERNEL_SYSCALL
    help
      Answer Y to enable LiteOS support shared memory.

config KERNEL_LITEIPC
    bool "Enable liteipc"
    default y
    depends on KERNEL_EXTKERNEL && KERNEL_VM
    help
      Answer Y to enable LiteOS support liteipc.

config KERNEL_PIPE
    bool "Enable pipes"
    default y
    depends on KERNEL_EXTKERNEL
    help
      Answer Y to enable LiteOS support pipes.

config KERNEL_PLIMITS
    bool "Enable plimits Feature"
    default n
    depends on KERNEL_EXTKERNEL

config KERNEL_MEM_PLIMIT
    bool "Enable mem limits Feature"
    default n
    depends on KERNEL_PLIMITS

config KERNEL_IPC_PLIMIT
    bool "Enable ipc limits Feature"
    default n
    depends on KERNEL_PLIMITS

config KERNEL_DEV_PLIMIT
    bool "Enable dev limits Feature"
    default n
    depends on KERNEL_PLIMITS

config KERNEL_SCHED_PLIMIT
    bool "Enable sched limits Feature"
    default n
    depends on KERNEL_PLIMITS

config BASE_CORE_HILOG
    bool "Enable Hilog"
    default y
    depends on KERNEL_EXTKERNEL
    help
      If you wish to include hilog.

config KERNEL_HOOK
    bool "Enable Hook Feature"
    default n
    depends on KERNEL_EXTKERNEL && DEBUG_VERSION


######################### config options of container ####################
config KERNEL_CONTAINER
    bool "Enable container Feature"
    default n
    depends on KERNEL_VM

config PID_CONTAINER
    bool "Enable pid container Feature"
    default n
    depends on KERNEL_CONTAINER

config UTS_CONTAINER
    bool "Enable uts container Feature"
    default n
    depends on KERNEL_CONTAINER

config MNT_CONTAINER
    bool "Enable mnt container Feature"
    default n
    depends on KERNEL_CONTAINER

config CHROOT
    bool "Enable chroot"
    default n
    depends on MNT_CONTAINER

config IPC_CONTAINER
    bool "Enable ipc container Feature"
    default n
    depends on KERNEL_CONTAINER

config TIME_CONTAINER
    bool "Enable time container"
    default n
    depends on KERNEL_CONTAINER

config USER_CONTAINER
    bool "Enable user container"
    default n
    depends on KERNEL_CONTAINER

config NET_CONTAINER
    bool "Enable net container"
    default n
    depends on KERNEL_CONTAINER


######################### config options of trace #########################
source "kernel/extended/trace/Kconfig"

######################### config options of blackbox #########################
source "kernel/extended/blackbox/Kconfig"

######################### config options of hidumper #########################
source "kernel/extended/hidumper/Kconfig"

######################### config options of perf #########################
source "kernel/extended/perf/Kconfig"

######################### config options of lms #########################
source "kernel/extended/lms/Kconfig"

######################### config options of hilog #########################
source "kernel/extended/hilog/Kconfig"
```

## kernel/extended/hidumper/Kconfig
```kconfig
config HIDUMPER
    bool "Enable hidumper"
    default n
    depends on KERNEL_EXTKERNEL
    help
      Answer Y to enable LiteOS support hidumper
```

## kernel/extended/hilog/Kconfig
```kconfig
config HILOG
    tristate "Hilog support"
    default y
    help
      hilog buffer manager.

      Hilog is a simple log manager for OpenHarmonyOS.
      log string write to /dev/hilog, and the hilog driver copy it
      to the ring buffer. Ring buffer can be read from userspace.

config HILOG_BUFFER_SIZE
    int "hilog buffer size"
    default 4096
    help
      Define the default ring buffer size of hilog
```

## kernel/extended/lms/Kconfig
```kconfig
config KERNEL_LMS
    bool "Enable Lite Memory Sanitizer"
    default n
    depends on KERNEL_EXTKERNEL && DEBUG_VERSION && LIB_LIBC
    help
      Select y to build LiteOS with memory sanitizer.

config LMS_MAX_RECORD_POOL_NUM
    int "Lms check pool max num"
    default 50
    depends on KERNEL_LMS
    help
      The Max num of lms check pool

config LMS_LOAD_CHECK
    bool "Enable lms read check"
    default y
    depends on KERNEL_LMS
    help
      Select y to enable read check.

config LMS_STORE_CHECK
    bool "Enable lms write check"
    default y
    depends on KERNEL_LMS
    help
      Select y to enable write check.

config LMS_CHECK_STRICT
    bool "Enable lms strict check, byte-by-byte"
    default n
    depends on KERNEL_LMS
    help
      Select y to enable byte-by-byte check in lms

config LMS_LIBC_FULL_CHECK
   bool "Enable libc all function do lms check"
   default n
   depends on KERNEL_LMS
   help
     Select y to enable libc full check
```

## kernel/extended/perf/Kconfig
```kconfig
config KERNEL_PERF
    bool "Enable Perf Feature"
    default n
    depends on KERNEL_EXTKERNEL
    select KERNEL_SMP_CALL if KERNEL_SMP
    help
      If you wish to build LiteOS with support for perf.

choice
    prompt "Time-consuming Calc Methods"
    depends on KERNEL_PERF

config PERF_CALC_TIME_BY_TICK
    bool "By Tick"

config PERF_CALC_TIME_BY_CYCLE
    bool "By Cpu Cycle"
endchoice

config PERF_BUFFER_SIZE
    int "Perf Sampling Buffer Size"
    default 20480
    depends on KERNEL_PERF

config PERF_HW_PMU
    bool "Enable Hardware Pmu Events for Sampling"
    default n
    depends on KERNEL_PERF

config PERF_TIMED_PMU
    bool "Enable Hrtimer Period Events for Sampling"
    default n
    depends on KERNEL_PERF && HRTIMER_ENABLE

config PERF_SW_PMU
    bool "Enable Software Events for Sampling"
    default y
    depends on KERNEL_PERF && KERNEL_HOOK
```

## kernel/extended/trace/Kconfig
```kconfig
config KERNEL_TRACE
    bool "Enable Trace Feature"
    default n
    depends on KERNEL_HOOK

config TRACE_MSG_EXTEND
    bool "Enable Record more extended content"
    default n
    depends on KERNEL_TRACE

config TRACE_FRAME_CORE_MSG
    bool "Record cpuid, hardware interrupt status, task lock status"
    default n
    depends on TRACE_MSG_EXTEND

config TRACE_FRAME_EVENT_COUNT
    bool "Record event count, which indicate the sequence of happend events"
    default n
    depends on TRACE_MSG_EXTEND

config TRACE_FRAME_MAX_PARAMS
    int "Record max params"
    default 3
    depends on KERNEL_TRACE
    help
      Make sure the max value is bigger than the number defined by each #MODULE#_#TYPE#_PARMAS in los_trace.h, e.g. TASK_SWITCH_PARAMS

choice
    prompt "Trace work mode"
    default RECORDER_MODE_OFFLINE
    depends on KERNEL_TRACE

config RECORDER_MODE_ONLINE
    bool "Online mode"
    select TRACE_CLIENT_INTERACT

config RECORDER_MODE_OFFLINE
    bool "Offline mode"

endchoice

config TRACE_BUFFER_SIZE
    int "Trace record buffer size"
    default 10000
    depends on RECORDER_MODE_OFFLINE

config TRACE_CLIENT_INTERACT
    bool "Enable Trace Client Visualization and Control"
    default n
    depends on KERNEL_TRACE

choice
    prompt "Trace Pipeline for Data Transmission"
    depends on TRACE_CLIENT_INTERACT

config TRACE_PIPELINE_SERIAL
    bool "Via Serial"

endchoice

choice
    prompt "Trace Control"
    default TRACE_CONTROL_VIA_SHELL
    depends on TRACE_CLIENT_INTERACT
    help
      If you wish to control Trace's start/stop etc.,dynamically by Trace Client.

config TRACE_CONTROL_VIA_SHELL
    bool "Via Shell"
    select LOSCFG_SHELL

config TRACE_CONTROL_AGENT
    bool "Via Trace Agent Task"

config TRACE_NO_CONTROL
    bool "No Control"

endchoice
```

## platform/Kconfig
```kconfig
config PLATFORM
    string
    default "hi3516dv300"     if PLATFORM_HI3516DV300
    default "hi3518ev300"     if PLATFORM_HI3518EV300
    default "virt"            if PLATFORM_QEMU_ARM_VIRT_CA7

config PRODUCT_NAME
    string "product name"
    default "ipcamera_hi3516dv300_liteos" if PRODUCT_IPCAMERA_HI3516DV300_LITEOS
    default "ipcamera_hi3518ev300_liteos" if PRODUCT_IPCAMERA_HI3518EV300_LITEOS
    default "hispark_taurus" if PRODUCT_HISPARK_TAURUS
    default "hispark_aries" if PRODUCT_HISPARK_ARIES
    default "arm_virt" if PRODUCT_QEMU_ARM

config DEVICE_COMPANY
    string "vendor name"
    default "hisilicon" if PLATFORM_HI3516DV300
    default "hisilicon" if PLATFORM_HI3518EV300
    default "qemu" if PLATFORM_QEMU_ARM_VIRT_CA7

choice
    prompt "Chip"
    default PLATFORM_HI3516DV300
    help
      IP Camera has several chips:
       - hi3516dv300
       - hi3518ev300
      Qemu ARM Virt variants (based on different CPU types):
       - qemu_arm_virt_ca7

config PLATFORM_HI3516DV300
    bool "hi3516dv300"
    select ARCH_CORTEX_A7

config PLATFORM_HI3518EV300
    bool "hi3518ev300"
    select ARCH_CORTEX_A7

config PLATFORM_QEMU_ARM_VIRT_CA7
    bool "qemu_arm_virt_ca7"
    select ARCH_CORTEX_A7
    help
        QEMU ARM Virtual Platform using Cortex-A7 CPU.

endchoice

choice
    prompt "Porduct"
    help
      Select your target board.

config PRODUCT_IPCAMERA_HI3516DV300_LITEOS
    bool "ipcamera_hi3516dv300_liteos" if PLATFORM_HI3516DV300
config PRODUCT_HISPARK_TAURUS
    bool "hispark_taurus" if PLATFORM_HI3516DV300

config PRODUCT_IPCAMERA_HI3518EV300_LITEOS
    bool "ipcamera_hi3518ev300_liteos" if PLATFORM_HI3518EV300
config PRODUCT_HISPARK_ARIES
    bool "hispark_aries" if PLATFORM_HI3518EV300

config PRODUCT_QEMU_ARM
    bool "arm_virt" if PLATFORM_QEMU_ARM_VIRT_CA7
endchoice

config BOARD_CONFIG_PATH
    string "BOARD CONFIG PATH"
    default "config/board"

config TEE_ENABLE
    bool "ENABLE TEE"
    default n
    depends on PLATFORM_HI3516DV300
    help
        ENABLE teeos in platform

config HRTIMER_ENABLE
    bool "HR TIMER enable"
    default y
    help
      Enable High-resolution timer support
```
