## Kconfig
```kconfig
# Copyright (c) 2013-2019 Huawei Technologies Co., Ltd. All rights reserved.
# Copyright (c) 2020-2021 Huawei Device Co., Ltd. All rights reserved.
#
# Redistribution and use in source and binary forms, with or without modification,
# are permitted provided that the following conditions are met:
#
# 1. Redistributions of source code must retain the above copyright notice, this list of
#    conditions and the following disclaimer.
#
# 2. Redistributions in binary form must reproduce the above copyright notice, this list
#    of conditions and the following disclaimer in the documentation and/or other materials
#    provided with the distribution.
#
# 3. Neither the name of the copyright holder nor the names of its contributors may be used
#    to endorse or promote products derived from this software without specific prior written
#    permission.
#
# THIS SOFTWARE IS PROVIDED BY THE COPYRIGHT HOLDERS AND CONTRIBUTORS
# "AS IS" AND ANY EXPRESS OR IMPLIED WARRANTIES, INCLUDING, BUT NOT LIMITED TO,
# THE IMPLIED WARRANTIES OF MERCHANTABILITY AND FITNESS FOR A PARTICULAR
# PURPOSE ARE DISCLAIMED. IN NO EVENT SHALL THE COPYRIGHT HOLDER OR
# CONTRIBUTORS BE LIABLE FOR ANY DIRECT, INDIRECT, INCIDENTAL, SPECIAL,
# EXEMPLARY, OR CONSEQUENTIAL DAMAGES (INCLUDING, BUT NOT LIMITED TO,
# PROCUREMENT OF SUBSTITUTE GOODS OR SERVICES; LOSS OF USE, DATA, OR PROFITS;
# OR BUSINESS INTERRUPTION) HOWEVER CAUSED AND ON ANY THEORY OF LIABILITY,
# WHETHER IN CONTRACT, STRICT LIABILITY, OR TORT (INCLUDING NEGLIGENCE OR
# OTHERWISE) ARISING IN ANY WAY OUT OF THE USE OF THIS SOFTWARE, EVEN IF
# ADVISED OF THE POSSIBILITY OF SUCH DAMAGE.

mainmenu "Huawei LiteOS Configuration"

menu "Compiler"
choice
    prompt "Compiler type"
    default COMPILER_CLANG_LLVM
    help
      Choose compiler type.

config COMPILER_GCC
    bool "GCC"

config CROSS_COMPILE
    string "GCC cross-compile toolchain prefix"
    depends on COMPILER_GCC
    default "arm-linux-ohoseabi-" if ARCH_ARM_AARCH32

config COMPILER_CLANG_LLVM
    bool "Clang"

config LLVM_TARGET
    string "Clang LLVM target"
    depends on COMPILER_CLANG_LLVM
    default "arm-liteos" if ARCH_ARM_AARCH32

endchoice

config COMPILE_DEBUG
    bool "Enable debug options"
    default n
    help
      Answer Y to add -g option in compile command.

config COMPILE_OPTIMIZE
    bool "Enable code optimization options"
    default y
    help
      Answer Y to add optimization options for efficient code.
      The final binary size will be smaller and execute faster.
      But the debugging experience may be worst somehow.

config COMPILE_OPTIMIZE_SIZE
    bool "Enable code size optimization options" if COMPILE_OPTIMIZE
    default y
    help
      Answer Y to add optimization options for small code size.
      The final binary size will be smaller.
      But the compile time may be a bit longer.

config COMPILE_LTO
    bool "Enable link time optimization (LTO)" if COMPILE_OPTIMIZE_SIZE
    default y
    help
      Answer Y to add lto options for more smaller code size.
      The final binary size will be smaller.
      But the compile time may be much longer.

endmenu

menu "Platform"

######################### config options of bsp #####################
source "platform/Kconfig"

######################### config options of cpu arch ################
source "arch/Kconfig"

config QUICK_START
    bool "Enable QUICK_START"
    default n
    depends on DRIVERS && FS_VFS
    help
      Answer Y to enable LiteOS support quick start.
endmenu

######################### config options of kernel #####################
source "kernel/Kconfig"
######################### config options of lib ########################
source "lib/Kconfig"
######################### config options of compatibility ##############
menu "Compat"
source "compat/posix/Kconfig"
source "bsd/Kconfig"
endmenu

######################## config options of filesystem ##################
menu "FileSystem"
source "fs/Kconfig"
endmenu

######################## config options of net ############################
source "net/Kconfig"

######################## config options of debug ########################
menu "Debug"
config GDB
    bool "Enable gdb functions"
    default n
    help
      Answer Y to enable gdb functions.

config PLATFORM_ADAPT
    bool "Enable Os_adapt"
    default y
    help
      Answer Y to add os_adapt.c to LiteOS.

config ENABLE_OOM_LOOP_TASK
    bool "Enable Oom loop task"
    default n
    depends on KERNEL_VM
    help
      Answer Y to enable oom loop kthread to check system out of memory.

config DO_ALIGN
    bool "Enable do align for hi3518e"
    default y
    depends on PLATFORM_HI3518EV200
    help
      Answer Y to enable do align for hi3518e.


config ENABLE_MAGICKEY
    bool "Enable MAGIC KEY"
    default y
    help
      Answer Y to enable LiteOS Magic key.
        ctrl + r : Magic key check switch;
        ctrl + z : Show all magic op key;
        ctrl + t : Show task information;
        ctrl + p : System panic;
        ctrl + e : Check system memory pool.

config THUMB
    bool "Enable Thumb"
    default n
    depends on ARCH_ARM
    help
      Answer Y to build thumb version.  This will make LiteOS smaller.

config PLATFORM_DVFS
    bool "Enable Dvfs"
    default n
    depends on  COMPAT_LINUXKPI
    help
      Answer Y to enable LiteOS support dynamic voltage and frequency scaling feature for
      low power consumption.

config SAVE_EXCINFO
    bool "Enable Saving Exception Information"
    default n
    help
      Answer Y to enable LiteOS support saving exception information to storage medium.

config DEBUG_VERSION
    bool "Enable a Debug Version"
    default n
    help
      If you do not select this option that means you enable a release version for LiteOS.
      It also means you do not want to use debug modules, like shell,telnet,tftp,nfs and
      memory check, etc.
      If you select this option that means you enable a debug version for LiteOS.
      That means you want a opposite behaviour compared to release version.

config DEBUG_KERNEL
    bool "Enable Debug LiteOS Kernel Resource"
    default n
    depends on DEBUG_VERSION
    help
      If you select this option that means you enable debugging kernel resource.
      It also means you want to get queue, mutex, semaphore, memory debug information.
      That means you want a opposite behaviour compared to release version.

config DEBUG_QUEUE
    bool "Enable Queue Debugging"
    default n
    depends on DEBUG_KERNEL
    help
      Answer Y to enable debug queue.

config DEBUG_DEADLOCK
    bool "Enable Mutex Deadlock Debugging"
    default n
    depends on DEBUG_KERNEL
    help
      Answer Y to enable debug mutex deadlock.

config DEBUG_SEMAPHORE
    bool "Enable Semaphore Debugging"
    default n
    depends on DEBUG_KERNEL
    help
      Answer Y to enable debug semaphore.

source "shell/Kconfig"
config NET_LWIP_SACK_TFTP
    bool "Enable Tftp"
    default y
    depends on SHELL && NET_LWIP_SACK && DEBUG_VERSION
    help
      Answer Y to enable LiteOS support tftp cmd and tftp tool.
source "net/telnet/Kconfig"
config SCHED_DEBUG
    bool "Enable sched debug Feature"
    default n
    depends on DEBUG_VERSION
    help
      If you wish to build LiteOS with support for sched debug.

config USER_INIT_DEBUG
    bool "Enable user init Debug"
    default n
    depends on DEBUG_VERSION

config SHELL_CMD_DEBUG
    bool "Enable shell cmd Debug"
    default n
    depends on DEBUG_VERSION && SHELL

config USB_DEBUG
    bool "Enable USB Debug"
    default n
    depends on SHELL && DRIVERS_USB && DEBUG_VERSION
    help
      Answer Y to enable LiteOS support usb debug.
      use shell command to open the specified debug level print.
config MEM_DEBUG
    bool "Enable MEM Debug"
    default n
    depends on DEBUG_VERSION
    help
      Answer Y to enable LiteOS support mem debug.

config MEM_LEAKCHECK
    bool "Enable Function call stack of Mem operation recorded"
    default n
    depends on DEBUG_VERSION && MEM_DEBUG
    help
      Answer Y to enable record the LR of Function call stack of Mem operation, it can check the mem leak through the infomations of mem node.
config BASE_MEM_NODE_INTEGRITY_CHECK
    bool "Enable integrity check or not"
    default n
    depends on DEBUG_VERSION && MEM_DEBUG
config MEM_WATERLINE
    bool "Enable memory pool waterline or not"
    default n
    depends on DEBUG_VERSION && MEM_DEBUG

config VM_OVERLAP_CHECK
    bool "Enable VM overlap check or not"
    default n
    depends on DEBUG_VERSION && MEM_DEBUG
    help
      Answer Y to enable vm overlap check.

endmenu

######################## config options os drivers ########################
menu "Driver"
source "drivers/Kconfig"
endmenu

######################## config options os security #######################
menu "Security"
source "security/Kconfig"
endmenu

menu "Test"
config ENABLE_KERNEL_TEST
    bool "Enable Kernel Test"
    default n
endmenu

menu "Stack Smashing Protector (SSP) Compiler Feature"

choice
    prompt "Enable stack buffer overflow detection"
    default  CC_STACKPROTECTOR_STRONG
    ---help---
    This option turns on the -fstack-protector GCC feature. This
    feature puts, at the beginning of functions, a canary value on
    the stack just before the return address, and validates
    the value just before actually returning.  Stack based buffer
    overflows (that need to overwrite this return address) now also
    overwrite the canary, which gets detected and the attack is then
    neutralized via a kernel panic.

    This feature requires gcc version 4.2 or above, or a distribution
    gcc with the feature backported. Older versions are automatically
    detected and for those versions, this configuration option is
    ignored. (and a warning is printed during bootup)

config CC_NO_STACKPROTECTOR
    bool "-fno-stack-protector"

config CC_STACKPROTECTOR
    bool "-fstack-protector"

config CC_STACKPROTECTOR_STRONG
    bool "-fstack-protector-strong"

config CC_STACKPROTECTOR_ALL
    bool "-fstack-protector-all"

endchoice

endmenu
```

## bsd/Kconfig
```kconfig
config  COMPAT_BSD
    bool "Enable FreeBSD"
    default y
    select COMPAT_LINUXKPI

    help
      Answer Y to enable LiteOS support FreeBSD.

config  COMPAT_LINUXKPI
    bool "Enable linuxkpi" if COMPAT_BSD
    default y

    help
      Answer Y to enable LiteOS support compatible layer for linuxkpi.
```

## drivers/Kconfig
```kconfig
config DRIVERS
    bool "Enable Driver"
    default y
    help
      Answer Y to enable LiteOS support driver.

source "bsd/dev/usb/Kconfig"
source "../../drivers/adapter/khdf/liteos/Kconfig"

# Device driver Kconfig import
source "$(DEVICE_PATH)/drivers/Kconfig"

source "drivers/char/mem/Kconfig"
source "drivers/char/quickstart/Kconfig"
source "drivers/char/random/Kconfig"
source "drivers/char/video/Kconfig"
source "drivers/char/trace/Kconfig"
source "drivers/char/perf/Kconfig"

source "../../drivers/liteos/tzdriver/Kconfig"
source "../../drivers/liteos/hievent/Kconfig"
```

## drivers/char/perf/Kconfig
```kconfig
config DRIVERS_PERF
    bool "Enable PERF DRIVER"
    default y
    depends on DRIVERS && FS_VFS && KERNEL_PERF
    help
      Answer Y to enable LiteOS support perf in userspace.
```

## drivers/char/quickstart/Kconfig
```kconfig
config DRIVERS_QUICKSTART
    bool "Enable QUICKSTART"
    default y
    depends on DRIVERS && FS_VFS
    help
      Answer Y to enable LiteOS support quickstart frame dev.
```

## drivers/char/trace/Kconfig
```kconfig
config DRIVERS_TRACE
    bool "Enable TRACE DRIVER"
    default y
    depends on DRIVERS && FS_VFS && KERNEL_TRACE
    help
      Answer Y to enable LiteOS support trace in userspace.
```

## fs/Kconfig
```kconfig
source "fs/vfs/Kconfig"
source "fs/fat/Kconfig"
source "fs/ramfs/Kconfig"
source "fs/romfs/Kconfig"
source "fs/nfs/Kconfig"
source "fs/proc/Kconfig"
source "fs/jffs2/Kconfig"
source "fs/rootfs/Kconfig"
source "fs/patchfs/Kconfig"
source "fs/zpfs/Kconfig"
```

## fs/jffs2/Kconfig
```kconfig
config FS_JFFS
    bool "Enable JFFS2"
    default y
    depends on FS_VFS
    help
      Answer Y to enable LiteOS support jffs2 filesystem.

config FS_JFFS2_SUMMARY
    bool "Enable JFFS2 SUMMARY"
    default n
    depends on FS_JFFS
    help
      Answer Y to enable LiteOS jffs2 filesystem support Summary Patch.
```

## fs/nfs/Kconfig
```kconfig
config FS_NFS
    bool "Enable NFS"
    default y
    depends on FS_VFS
    depends on NET_LWIP_SACK
    depends on DEBUG_VERSION
    help
      Answer Y to enable LiteOS support nfs filesystem.
```

## fs/patchfs/Kconfig
```kconfig
config PLATFORM_PATCHFS
    bool "Enable PATCHFS"
    default n
    depends on FS_JFFS
    help
      Answer Y to enable LiteOS support patchfs.
```

## fs/proc/Kconfig
```kconfig
config FS_PROC
    bool "Enable PROC"
    default y
    depends on FS_VFS
    help
      Answer Y to enable LiteOS support proc filesystem.

config PROC_PROCESS_DIR
    bool "Enable Process mount directory"
    default n
    depends on FS_PROC
```

## fs/romfs/Kconfig
```kconfig
config FS_ROMFS
    bool "Enable ROMFS"
    default n
    depends on FS_VFS
    help
      Answer Y to enable LiteOS support romfs filesystem.
```

## fs/rootfs/Kconfig
```kconfig
config PLATFORM_ROOTFS
    bool "Enable ROOTFS"
    default y
    depends on FS_JFFS || FS_FAT || DRIVERS_MTD_NAND
    help
      Answer Y to enable LiteOS support rootfs.

choice
    prompt "Storage device type"
    default STORAGE_SPINOR
    depends on PLATFORM_ROOTFS
    help
      SPI_NOR or SPI_NAND or EMMC.

config STORAGE_SPINOR
    depends on PLATFORM_ROOTFS && DRIVERS_MTD_SPI_NOR
    bool "SPI_NOR Flash"

config STORAGE_SPINAND
    depends on PLATFORM_ROOTFS && DRIVERS_MTD_NAND
    bool "SPI_NAND Flash"

config STORAGE_EMMC
    depends on PLATFORM_ROOTFS && DRIVERS_EMMC
    bool "EMMC"

endchoice

config BOOTENV_ADDR
    int "Address of boot command line (KB)"
    depends on PLATFORM_ROOTFS && (STORAGE_SPINOR || STORAGE_SPINAND || STORAGE_EMMC)
    default 512
    help
      Boot command line addr.

config BOOTENV_RAM
    bool "Read bootenv from RAM"
    default n
    depends on PLATFORM_ROOTFS
    help
      Answer Y to read bootenv from ram. Need boot copy to RAM.

config BOOTENV_RAMSIZE
    int "Size of boot environment in RAM (Byte)"
    depends on PLATFORM_ROOTFS && BOOTENV_RAM
    range 128 1024
    default 512
    help
      Boot environment in Ram space size, range from 128 to 1024 byte.
```

## fs/vfs/Kconfig
```kconfig
config FS_VFS
    bool "Enable VFS"
    default y

    help
      Answer Y to enable LiteOS support virtual filesystem.

config FS_VFS_BLOCK_DEVICE
    bool "Enable Block DEVICE"
    default n
    depends on FS_VFS
    help
      Answer Y to enable LiteOS support read/open/seek/write block device.

config FILE_MODE
    bool "Enable FILE MODE"
    default y
    depends on FS_VFS
    help
      Answer Y to enable LiteOS support file mode.

config ENABLE_READ_BUFFER
    bool "Enable read buffer Option"
    default n
    depends on FS_VFS
    help
      Answer Y to add enable read buffer Option.

config MAX_VNODE_SIZE
    int "Vnode max number"
    range 0 512
    default 512
    depends on FS_VFS
    help
      vnode number, range from 0 to 512.

config MAX_PATH_CACHE_SIZE
    int "PathCache max number"
    range 0 1024
    default 512
    depends on FS_VFS
    help
      pathCache number, range from 0 to 1024.
```

## fs/zpfs/Kconfig
```kconfig
config FS_ZPFS
    bool "Enable ZPFS"
    default y
    depends on FS_VFS && PLATFORM_PATCHFS
    help
      Answer Y to enable LiteOS support zpfs filesystem.
```
